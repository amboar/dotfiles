## src/kernel.org/linux/origin/build.arm.aspeed_g5/ast2600.its
```
/dts-v1/;

/ {
        description = "Kernel fitImage for Phosphor OpenBMC (Phosphor OpenBMC Project Reference Distro)/6.12.59+git/cc-nvme-mi";
        #address-cells = <1>;

        images {
                kernel-1 {
                        description = "Linux kernel";
                        data = /incbin/("arch/arm/boot/zImage");
                        type = "kernel";
                        arch = "arm";
                        os = "linux";
                        compression = "none";
                        load = <0x80001000>;
                        entry = <0x80001000>;
                        hash-1 {
                                algo = "sha256";
                        };
                };
                fdt-aspeed-ast2600-evb.dtb {
                        description = "Flattened Device Tree blob";
                        data = /incbin/("arch/arm/boot/dts/aspeed/aspeed-ast2600-evb.dtb");
                        type = "flat_dt";
                        arch = "arm";
                        compression = "none";
                        
                        hash-1 {
                                algo = "sha256";
                        };
                };
                ramdisk-1 {
                        description = "obmc-phosphor-initramfs";
                        data = /incbin/("/home/andrew/src/openbmc.org/openbmc/openbmc/origin/build/cc-nvme-mi/tmp/deploy/images/cc-nvme-mi/obmc-phosphor-initramfs-cc-nvme-mi.cpio.xz");
                        type = "ramdisk";
                        arch = "arm";
                        os = "linux";
                        compression = "none";
                        
                        
                        hash-1 {
                                algo = "sha256";
                        };
                };
	};

        configurations {
                default = "conf-aspeed-ast2600-evb.dtb";
                conf-aspeed-ast2600-evb.dtb {
                        description = "1 Linux kernel, FDT blob, ramdisk";
                        
                        kernel = "kernel-1";
                        fdt = "fdt-aspeed-ast2600-evb.dtb";
                        ramdisk = "ramdisk-1";
                        
                        
                        hash-1 {
                                algo = "sha256";
                        };
                };
	};
};
```

## src/kernel.org/linux/origin/build.arm64.default/ast2700.its
```
/dts-v1/;

/ {
        description = "Kernel FIT image";
        #address-cells = <2>;
        images {
                kernel-1 {
                        description = "Linux kernel";
                        type = "kernel";
                        compression = "none";
                        data = /incbin/("arch/arm64/boot/Image");
                        arch = "arm64";
                        os = "linux";
                        load = <0x4 0x00000000>;
                        entry = <0x4 0x00000000>;
                        hash-1 {
                                algo = "sha256";
                        };
                };
                fdt-ast2700-evb.dtb {
                        description = "Flattened Device Tree blob";
                        type = "flat_dt";
                        compression = "none";
                        data = /incbin/("arch/arm64/boot/dts/aspeed/ast2700-evb.dtb");
                        arch = "arm64";
                        hash-1 {
                                algo = "sha256";
                        };
                };
                ramdisk-1 {
                        description = "buildroot-initramfs";
                        type = "ramdisk";
                        compression = "none";
                        data = /incbin/("/home/andrew/Artefacts/buildroot.org/armv8.busybox.cpio/output/images/rootfs.cpio");
                        arch = "arm64";
                        os = "linux";
                        hash-1 {
                                algo = "sha256";
                        };
                };
        };
        configurations {
                default = "conf-ast2700-evb.dtb";
                conf-ast2700-evb.dtb {
                        description = "1 Linux kernel, FDT blob, ramdisk";
                        kernel = "kernel-1";
                        fdt = "fdt-ast2700-evb.dtb";
                        ramdisk = "ramdisk-1";
                        hash-1 {
                                algo = "sha256";
                        };
                };
        };
};
```
